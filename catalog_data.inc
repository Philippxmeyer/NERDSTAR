// Generated from data/catalog.xml
static constexpr storage::CatalogEntry kCatalogEntries[] = {
    {0, 7, 7, 7, 0, 0, 0, -29},
    {14, 4, 18, 4, 0, 0, 0, -20},
    {22, 7, 29, 7, 0, 0, 0, -19},
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    {5554, 8, 5562, 8, 7, 22494, -2084, 73},
};
static constexpr char kCatalogStrings[] = {
    'J', 'u', 'p', 'i', 't', 'e', 'r', 'J', 'u', 'p', 'i', 't',
    'e', 'r', 'M', 'a', 'r', 's', 'M', 'a', 'r', 's', 'M', 'e',
    'r', 'c', 'u', 'r', 'y', 'M', 'e', 'r', 'c', 'u', 'r', 'y',
    'N', 'e', 'p', 't', 'u', 'n', 'e', 'N', 'e', 'p', 't', 'u',
    'n', 'e', 'S', 'a', 't', 'u', 'r', 'n', 'S', 'a', 't', 'u',
    'r', 'n', 'U', 'r', 'a', 'n', 'u', 's', 'U', 'r', 'a', 'n',
    'u', 's', 'V', 'e', 'n', 'u', 's', 'V', 'e', 'n', 'u', 's',
    'E', 'a', 'r', 't', 'h', ' ', 'M', 'o', 'o', 'n', 'E', 'a',
    'r', 't', 'h', ' ', 'M', 'o', 'o', 'n', 'A', 'c', 'h', 'e',
    'r', 'n', 'a', 'r', 'a', 'l', 'p', 'h', 'a', ' ', 'e', 'r',
    'i', 'd', 'a', 'n', 'i', 'A', 'c', 'r', 'u', 'x', 'a', 'l',
    'p', 'h', 'a', ' ', 'c', 'r', 'u', 'c', 'i', 's', 'A', 'd',
    'h', 'a', 'r', 'a', 'e', 'p', 's', 'i', 'l', 'o', 'n', ' ',
    'c', 'a', 'n', 'i', 's', ' ', 'm', 'a', 'j', 'o', 'r', 'i',
    's', 'A', 'l', 'c', 'y', 'o', 'n', 'e', 'e', 't', 'a', ' ',
    't', 'a', 'u', 'r', 'i', 'A', 'l', 'd', 'e', 'b', 'a', 'r',
    'a', 'n', 'a', 'l', 'p', 'h', 'a', ' ', 't', 'a', 'u', 'r',
    'i', 'A', 'l', 'g', 'o', 'l', 'b', 'e', 't', 'a', ' ', 'p',
    'e', 'r', 's', 'e', 'i', 'A', 'l', 'h', 'e', 'n', 'a', 'g',
    'a', 'm', 'm', 'a', ' ', 'g', 'e', 'm', 'i', 'n', 'o', 'r',
    'u', 'm', 'A', 'l', 'i', 'o', 't', 'h', 'e', 'p', 's', 'i',
    'l', 'o', 'n', ' ', 'u', 'r', 's', 'a', 'e', ' ', 'm', 'a',
    'j', 'o', 'r', 'i', 's', 'A', 'l', 'n', 'a', 'i', 'r', 'a',
    'l', 'p', 'h', 'a', ' ', 'g', 'r', 'u', 'i', 's', 'A', 'l',
    'n', 'i', 'l', 'a', 'm', 'e', 'p', 's', 'i', 'l', 'o', 'n',
    ' ', 'o', 'r', 'i', 'o', 'n', 'i', 's', 'A', 'l', 'p', 'h',
    'a', ' ', 'C', 'e', 'n', 't', 'a', 'u', 'r', 'i', 'a', 'l',
    'p', 'h', 'a', ' ', 'c', 'e', 'n', 't', 'a', 'u', 'r', 'i',
    'A', 'l', 'p', 'h', 'a', 'r', 'd', 'a', 'l', 'p', 'h', 'a',
    ' ', 'h', 'y', 'd', 'r', 'a', 'e', 'A', 'l', 's', 'e', 'p',
    'h', 'i', 'n', 'a', 'd', 'e', 'l', 't', 'a', ' ', 'v', 'e',
    'l', 'o', 'r', 'u', 'm', 'A', 'l', 't', 'a', 'i', 'r', 'a',
    'l', 'p', 'h', 'a', ' ', 'a', 'q', 'u', 'i', 'l', 'a', 'e',
    'A', 'n', 't', 'a', 'r', 'e', 's', 'a', 'l', 'p', 'h', 'a',
    ' ', 's', 'c', 'o', 'r', 'p', 'i', 'i', 'A', 'r', 'c', 't',
    'u', 'r', 'u', 's', 'a', 'l', 'p', 'h', 'a', ' ', 'b', 'o',
    'o', 't', 'i', 's', 'A', 't', 'r', 'i', 'a', 'a', 'l', 'p',
    'h', 'a', ' ', 't', 'r', 'i', 'a', 'n', 'g', 'u', 'l', 'i',
    ' ', 'a', 'u', 's', 't', 'r', 'a', 'l', 'i', 's', 'B', 'e',
    'l', 'l', 'a', 't', 'r', 'i', 'x', 'g', 'a', 'm', 'm', 'a',
    ' ', 'o', 'r', 'i', 'o', 'n', 'i', 's', 'B', 'e', 't', 'e',
    'l', 'g', 'e', 'u', 's', 'e', 'a', 'l', 'p', 'h', 'a', ' ',
    'o', 'r', 'i', 'o', 'n', 'i', 's', 'C', 'a', 'n', 'o', 'p',
    'u', 's', 'a', 'l', 'p', 'h', 'a', ' ', 'c', 'a', 'r', 'i',
    'n', 'a', 'e', 'C', 'a', 'p', 'e', 'l', 'l', 'a', 'a', 'l',
    'p', 'h', 'a', ' ', 'a', 'u', 'r', 'i', 'g', 'a', 'e', 'C',
    'a', 's', 't', 'o', 'r', 'a', 'l', 'p', 'h', 'a', ' ', 'g',
    'e', 'm', 'i', 'n', 'o', 'r', 'u', 'm', 'D', 'e', 'n', 'e',
    'b', 'a', 'l', 'p', 'h', 'a', ' ', 'c', 'y', 'g', 'n', 'i',
    'D', 'e', 'n', 'e', 'b', 'o', 'l', 'a', 'b', 'e', 't', 'a',
    ' ', 'l', 'e', 'o', 'n', 'i', 's', 'D', 'u', 'b', 'h', 'e',
    'a', 'l', 'p', 'h', 'a', ' ', 'u', 'r', 's', 'a', 'e', ' ',
    'm', 'a', 'j', 'o', 'r', 'i', 's', 'E', 'l', 'n', 'a', 't',
    'h', 'b', 'e', 't', 'a', ' ', 't', 'a', 'u', 'r', 'i', 'E',
    'l', 't', 'a', 'n', 'i', 'n', 'g', 'a', 'm', 'm', 'a', ' ',
    'd', 'r', 'a', 'c', 'o', 'n', 'i', 's', 'E', 'n', 'i', 'f',
    'e', 'p', 's', 'i', 'l', 'o', 'n', ' ', 'p', 'e', 'g', 'a',
    's', 'i', 'F', 'o', 'm', 'a', 'l', 'h', 'a', 'u', 't', 'a',
    'l', 'p', 'h', 'a', ' ', 'p', 'i', 's', 'c', 'i', 's', ' ',
    'a', 'u', 's', 't', 'r', 'i', 'n', 'i', 'G', 'a', 'c', 'r',
    'u', 'x', 'g', 'a', 'm', 'm', 'a', ' ', 'c', 'r', 'u', 'c',
    'i', 's', 'H', 'a', 'd', 'a', 'r', 'b', 'e', 't', 'a', ' ',
    'c', 'e', 'n', 't', 'a', 'u', 'r', 'i', 'K', 'a', 'u', 's',
    ' ', 'A', 'u', 's', 't', 'r', 'a', 'l', 'i', 's', 'e', 'p',
    's', 'i', 'l', 'o', 'n', ' ', 's', 'a', 'g', 'i', 't', 't',
    'a', 'r', 'i', 'i', 'K', 'o', 'c', 'h', 'a', 'b', 'b', 'e',
    't', 'a', ' ', 'u', 'r', 's', 'a', 'e', ' ', 'm', 'i', 'n',
    'o', 'r', 'i', 's', 'M', 'a', 'r', 'k', 'a', 'b', 'a', 'l',
    'p', 'h', 'a', ' ', 'p', 'e', 'g', 'a', 's', 'i', 'M', 'e',
    'n', 'k', 'e', 'n', 't', 't', 'h', 'e', 't', 'a', ' ', 'c',
    'e', 'n', 't', 'a', 'u', 'r', 'i', 'M', 'i', 'a', 'p', 'l',
    'a', 'c', 'i', 'd', 'u', 's', 'b', 'e', 't', 'a', ' ', 'c',
    'a', 'r', 'i', 'n', 'a', 'e', 'M', 'i', 'm', 'o', 's', 'a',
    'b', 'e', 't', 'a', ' ', 'c', 'r', 'u', 'c', 'i', 's', 'M',
    'i', 'r', 'f', 'a', 'k', 'a', 'l', 'p', 'h', 'a', ' ', 'p',
    'e', 'r', 's', 'e', 'i', 'M', 'i', 'r', 'z', 'a', 'm', 'b',
    'e', 't', 'a', ' ', 'c', 'a', 'n', 'i', 's', ' ', 'm', 'a',
    'j', 'o', 'r', 'i', 's', 'P', 'e', 'a', 'c', 'o', 'c', 'k',
    'a', 'l', 'p', 'h', 'a', ' ', 'p', 'a', 'v', 'o', 'n', 'i',
    's', 'P', 'o', 'l', 'l', 'u', 'x', 'b', 'e', 't', 'a', ' ',
    'g', 'e', 'm', 'i', 'n', 'o', 'r', 'u', 'm', 'P', 'r', 'o',
    'c', 'y', 'o', 'n', 'a', 'l', 'p', 'h', 'a', ' ', 'c', 'a',
    'n', 'i', 's', ' ', 'm', 'i', 'n', 'o', 'r', 'i', 's', 'R',
    'a', 's', 'a', 'l', 'h', 'a', 'g', 'u', 'e', 'a', 'l', 'p',
    'h', 'a', ' ', 'o', 'p', 'h', 'i', 'u', 'c', 'h', 'i', 'R',
    'e', 'g', 'u', 'l', 'u', 's', 'a', 'l', 'p', 'h', 'a', ' ',
    'l', 'e', 'o', 'n', 'i', 's', 'R', 'i', 'g', 'e', 'l', 'b',
    'e', 't', 'a', ' ', 'o', 'r', 'i', 'o', 'n', 'i', 's', 'S',
    'a', 'r', 'g', 'a', 's', 't', 'h', 'e', 't', 'a', ' ', 's',
    'c', 'o', 'r', 'p', 'i', 'i', 'S', 'h', 'a', 'u', 'l', 'a',
    'l', 'a', 'm', 'b', 'd', 'a', ' ', 's', 'c', 'o', 'r', 'p',
    'i', 'i', 'S', 'i', 'r', 'i', 'u', 's', 'a', 'l', 'p', 'h',
    'a', ' ', 'c', 'a', 'n', 'i', 's', ' ', 'm', 'a', 'j', 'o',
    'r', 'i', 's', 'S', 'p', 'i', 'c', 'a', 'a', 'l', 'p', 'h',
    'a', ' ', 'v', 'i', 'r', 'g', 'i', 'n', 'i', 's', 'V', 'e',
    'g', 'a', 'a', 'l', 'p', 'h', 'a', ' ', 'l', 'y', 'r', 'a',
    'e', 'W', 'e', 'z', 'e', 'n', 'd', 'e', 'l', 't', 'a', ' ',
    'c', 'a', 'n', 'i', 's', ' ', 'm', 'a', 'j', 'o', 'r', 'i',
    's', '4', '7', ' ', 'T', 'u', 'c', 'a', 'n', 'a', 'e', 'N',
    'G', 'C', ' ', '0', '1', '0', '4', 'A', 'r', 'a', ' ', 'C',
    'l', 'u', 's', 't', 'e', 'r', 'N', 'G', 'C', ' ', '6', '3',
    '9', '7', 'B', 'e', 'e', 'h', 'i', 'v', 'e', ' ', 'C', 'l',
    'u', 's', 't', 'e', 'r', 'M', 'e', 's', 's', 'i', 'e', 'r',
    ' ', '0', '4', '4', 'B', 'u', 't', 't', 'e', 'r', 'f', 'l',
    'y', ' ', 'C', 'l', 'u', 's', 't', 'e', 'r', 'M', 'e', 's',
    's', 'i', 'e', 'r', ' ', '0', '1', '0', 'B', 'u', 't', 't',
    'e', 'r', 'f', 'l', 'y', ' ', 'C', 'l', 'u', 's', 't', 'e',
    'r', 'M', 'e', 's', 's', 'i', 'e', 'r', ' ', '0', '9', '3',
    'D', 'o', 'u', 'b', 'l', 'e', ' ', 'C', 'l', 'u', 's', 't',
    'e', 'r', ' ', 'A', 'N', 'G', 'C', ' ', '0', '8', '6', '9',
    'D', 'o', 'u', 'b', 'l', 'e', ' ', 'C', 'l', 'u', 's', 't',
    'e', 'r', ' ', 'B', 'N', 'G', 'C', ' ', '0', '8', '8', '4',
    'G', 'r', 'e', 'a', 't', ' ', 'H', 'e', 'r', 'c', 'u', 'l',
    'e', 's', ' ', 'C', 'l', 'u', 's', 't', 'e', 'r', 'M', 'e',
    's', 's', 'i', 'e', 'r', ' ', '0', '1', '3', 'H', 'e', 'r',
    'c', 'u', 'l', 'e', 's', ' ', 'C', 'l', 'u', 's', 't', 'e',
    'r', 'M', 'e', 's', 's', 'i', 'e', 'r', ' ', '0', '0', '3',
    'K', 'i', 'n', 'g', ' ', 'C', 'o', 'b', 'r', 'a', ' ', 'C',
    'l', 'u', 's', 't', 'e', 'r', 'M', 'e', 's', 's', 'i', 'e',
    'r', ' ', '0', '6', '7', 'L', 'a', 'g', 'o', 'o', 'n', ' ',
    'C', 'l', 'u', 's', 't', 'e', 'r', 'N', 'G', 'C', ' ', '6',
    '5', '3', '0', 'L', 'i', 't', 't', 'l', 'e', ' ', 'B', 'e',
    'e', 'h', 'i', 'v', 'e', 'M', 'e', 's', 's', 'i', 'e', 'r',
    ' ', '0', '4', '1', 'L', 'y', 'r', 'a', ' ', 'C', 'l', 'u',
    's', 't', 'e', 'r', 'M', 'e', 's', 's', 'i', 'e', 'r', ' ',
    '0', '5', '6', 'M', '5', ' ', 'C', 'l', 'u', 's', 't', 'e',
    'r', 'M', 'e', 's', 's', 'i', 'e', 'r', ' ', '0', '0', '5',
    'M', 'e', 's', 's', 'i', 'e', 'r', ' ', '0', '1', '2', 'M',
    'e', 's', 's', 'i', 'e', 'r', ' ', '0', '1', '2', 'M', 'e',
    's', 's', 'i', 'e', 'r', ' ', '0', '1', '4', 'M', 'e', 's',
    's', 'i', 'e', 'r', ' ', '0', '1', '4', 'O', 'm', 'e', 'g',
    'a', ' ', 'C', 'e', 'n', 't', 'a', 'u', 'r', 'i', 'N', 'G',
    'C', ' ', '5', '1', '3', '9', 'P', 'e', 'r', 's', 'e', 'u',
    's', ' ', 'C', 'l', 'u', 's', 't', 'e', 'r', 'M', 'e', 's',
    's', 'i', 'e', 'r', ' ', '0', '3', '4', 'P', 'i', 'n', 'w',
    'h', 'e', 'e', 'l', ' ', 'C', 'l', 'u', 's', 't', 'e', 'r',
    'M', 'e', 's', 's', 'i', 'e', 'r', ' ', '0', '3', '6', 'P',
    'l', 'e', 'i', 'a', 'd', 'e', 's', 'M', 'e', 's', 's', 'i',
    'e', 'r', ' ', '0', '4', '5', 'P', 't', 'o', 'l', 'e', 'm',
    'y', ' ', 'C', 'l', 'u', 's', 't', 'e', 'r', 'M', 'e', 's',
    's', 'i', 'e', 'r', ' ', '0', '0', '7', 'S', 'a', 'g', 'i',
    't', 't', 'a', 'r', 'i', 'u', 's', ' ', 'C', 'l', 'u', 's',
    't', 'e', 'r', 'M', 'e', 's', 's', 'i', 'e', 'r', ' ', '0',
    '0', '9', 'S', 'a', 'g', 'i', 't', 't', 'a', 'r', 'i', 'u',
    's', ' ', 'C', 'l', 'u', 's', 't', 'e', 'r', 'M', 'e', 's',
    's', 'i', 'e', 'r', ' ', '0', '2', '2', 'S', 'a', 'g', 'i',
    't', 't', 'a', 'r', 'i', 'u', 's', ' ', 'C', 'l', 'u', 's',
    't', 'e', 'r', 'M', 'e', 's', 's', 'i', 'e', 'r', ' ', '0',
    '2', '5', 'S', 'a', 'g', 'i', 't', 't', 'a', 'r', 'i', 'u',
    's', ' ', 'D', 'w', 'a', 'r', 'f', ' ', 'C', 'l', 'u', 's',
    't', 'e', 'r', 'M', 'e', 's', 's', 'i', 'e', 'r', ' ', '0',
    '5', '4', 'S', 'a', 'g', 'i', 't', 't', 'a', 'r', 'i', 'u',
    's', ' ', 'S', 't', 'a', 'r', ' ', 'C', 'l', 'o', 'u', 'd',
    'M', 'e', 's', 's', 'i', 'e', 'r', ' ', '0', '2', '3', 'S',
    'a', 'l', 't', ' ', 'a', 'n', 'd', ' ', 'P', 'e', 'p', 'p',
    'e', 'r', ' ', 'C', 'l', 'u', 's', 't', 'e', 'r', 'M', 'e',
    's', 's', 'i', 'e', 'r', ' ', '0', '3', '7', 'S', 'h', 'o',
    'e', ' ', 'B', 'u', 'c', 'k', 'l', 'e', ' ', 'C', 'l', 'u',
    's', 't', 'e', 'r', 'M', 'e', 's', 's', 'i', 'e', 'r', ' ',
    '0', '3', '5', 'S', 't', 'a', 'r', 'f', 'i', 's', 'h', ' ',
    'C', 'l', 'u', 's', 't', 'e', 'r', 'M', 'e', 's', 's', 'i',
    'e', 'r', ' ', '0', '3', '8', 'S', 'u', 'm', 'm', 'e', 'r',
    ' ', 'R', 'o', 's', 'e', ' ', 'C', 'l', 'u', 's', 't', 'e',
    'r', 'M', 'e', 's', 's', 'i', 'e', 'r', ' ', '0', '5', '5',
    'W', 'i', 'l', 'd', ' ', 'D', 'u', 'c', 'k', ' ', 'C', 'l',
    'u', 's', 't', 'e', 'r', 'M', 'e', 's', 's', 'i', 'e', 'r',
    ' ', '0', '1', '1', 'A', 'l', 'b', 'i', 'r', 'e', 'o', 'A',
    'l', 'b', 'i', 'r', 'e', 'o', 'E', 'p', 's', 'i', 'l', 'o',
    'n', ' ', 'L', 'y', 'r', 'a', 'e', 'E', 'p', 's', 'i', 'l',
    'o', 'n', ' ', 'L', 'y', 'r', 'a', 'e', 'G', 'a', 'm', 'm',
    'a', ' ', 'V', 'i', 'r', 'g', 'i', 'n', 'i', 's', 'G', 'a',
    'm', 'm', 'a', ' ', 'V', 'i', 'r', 'g', 'i', 'n', 'i', 's',
    'M', 'i', 'z', 'a', 'r', 'M', 'i', 'z', 'a', 'r', 'A', 'n',
    'd', 'r', 'o', 'm', 'e', 'd', 'a', ' ', 'G', 'a', 'l', 'a',
    'x', 'y', 'M', 'e', 's', 's', 'i', 'e', 'r', ' ', '0', '3',
    '1', 'B', 'o', 'd', 'e', 's', ' ', 'G', 'a', 'l', 'a', 'x',
    'y', 'M', 'e', 's', 's', 'i', 'e', 'r', ' ', '0', '8', '1',
    'C', 'i', 'g', 'a', 'r', ' ', 'G', 'a', 'l', 'a', 'x', 'y',
    'M', 'e', 's', 's', 'i', 'e', 'r', ' ', '0', '8', '2', 'C',
    'r', 'o', 'c', 'u', 's', ' ', 'G', 'a', 'l', 'a', 'x', 'y',
    'M', 'e', 's', 's', 'i', 'e', 'r', ' ', '0', '9', '4', 'N',
    'e', 'e', 'd', 'l', 'e', ' ', 'G', 'a', 'l', 'a', 'x', 'y',
    'M', 'e', 's', 's', 'i', 'e', 'r', ' ', '1', '0', '6', 'N',
    'G', 'C', ' ', '0', '2', '5', '3', 'N', 'G', 'C', ' ', '0',
    '2', '5', '3', 'N', 'G', 'C', ' ', '2', '4', '0', '3', 'N',
    'G', 'C', ' ', '2', '4', '0', '3', 'N', 'G', 'C', ' ', '2',
    '9', '0', '3', 'N', 'G', 'C', ' ', '2', '9', '0', '3', 'N',
    'G', 'C', ' ', '3', '0', '0', '0', 'N', 'G', 'C', ' ', '3',
    '0', '0', '0', 'N', 'G', 'C', ' ', '3', '0', '0', '1', 'N',
    'G', 'C', ' ', '3', '0', '0', '1', 'N', 'G', 'C', ' ', '3',
    '0', '0', '2', 'N', 'G', 'C', ' ', '3', '0', '0', '2', 'N',
    'G', 'C', ' ', '3', '0', '0', '3', 'N', 'G', 'C', ' ', '3',
    '0', '0', '3', 'N', 'G', 'C', ' ', '3', '0', '0', '4', 'N',
    'G', 'C', ' ', '3', '0', '0', '4', 'N', 'G', 'C', ' ', '3',
    '0', '0', '5', 'N', 'G', 'C', ' ', '3', '0', '0', '5', 'N',
    'G', 'C', ' ', '3', '0', '0', '6', 'N', 'G', 'C', ' ', '3',
    '0', '0', '6', 'N', 'G', 'C', ' ', '3', '0', '0', '7', 'N',
    'G', 'C', ' ', '3', '0', '0', '7', 'N', 'G', 'C', ' ', '3',
    '0', '0', '8', 'N', 'G', 'C', ' ', '3', '0', '0', '8', 'N',
    'G', 'C', ' ', '3', '0', '0', '9', 'N', 'G', 'C', ' ', '3',
    '0', '0', '9', 'N', 'G', 'C', ' ', '3', '0', '1', '0', 'N',
    'G', 'C', ' ', '3', '0', '1', '0', 'N', 'G', 'C', ' ', '3',
    '0', '1', '1', 'N', 'G', 'C', ' ', '3', '0', '1', '1', 'N',
    'G', 'C', ' ', '3', '0', '1', '2', 'N', 'G', 'C', ' ', '3',
    '0', '1', '2', 'N', 'G', 'C', ' ', '3', '0', '1', '3', 'N',
    'G', 'C', ' ', '3', '0', '1', '3', 'N', 'G', 'C', ' ', '3',
    '0', '1', '4', 'N', 'G', 'C', ' ', '3', '0', '1', '4', 'N',
    'G', 'C', ' ', '3', '0', '1', '5', 'N', 'G', 'C', ' ', '3',
    '0', '1', '5', 'N', 'G', 'C', ' ', '3', '0', '1', '6', 'N',
    'G', 'C', ' ', '3', '0', '1', '6', 'N', 'G', 'C', ' ', '3',
    '0', '1', '7', 'N', 'G', 'C', ' ', '3', '0', '1', '7', 'N',
    'G', 'C', ' ', '3', '0', '1', '8', 'N', 'G', 'C', ' ', '3',
    '0', '1', '8', 'N', 'G', 'C', ' ', '3', '0', '1', '9', 'N',
    'G', 'C', ' ', '3', '0', '1', '9', 'N', 'G', 'C', ' ', '3',
    '0', '2', '0', 'N', 'G', 'C', ' ', '3', '0', '2', '0', 'N',
    'G', 'C', ' ', '3', '0', '2', '1', 'N', 'G', 'C', ' ', '3',
    '0', '2', '1', 'N', 'G', 'C', ' ', '3', '0', '2', '2', 'N',
    'G', 'C', ' ', '3', '0', '2', '2', 'N', 'G', 'C', ' ', '3',
    '0', '2', '3', 'N', 'G', 'C', ' ', '3', '0', '2', '3', 'N',
    'G', 'C', ' ', '3', '0', '2', '4', 'N', 'G', 'C', ' ', '3',
    '0', '2', '4', 'N', 'G', 'C', ' ', '3', '0', '2', '5', 'N',
    'G', 'C', ' ', '3', '0', '2', '5', 'N', 'G', 'C', ' ', '3',
    '0', '2', '6', 'N', 'G', 'C', ' ', '3', '0', '2', '6', 'N',
    'G', 'C', ' ', '3', '0', '2', '7', 'N', 'G', 'C', ' ', '3',
    '0', '2', '7', 'N', 'G', 'C', ' ', '3', '0', '2', '8', 'N',
    'G', 'C', ' ', '3', '0', '2', '8', 'N', 'G', 'C', ' ', '3',
    '0', '2', '9', 'N', 'G', 'C', ' ', '3', '0', '2', '9', 'N',
    'G', 'C', ' ', '3', '0', '3', '0', 'N', 'G', 'C', ' ', '3',
    '0', '3', '0', 'N', 'G', 'C', ' ', '3', '0', '3', '1', 'N',
    'G', 'C', ' ', '3', '0', '3', '1', 'N', 'G', 'C', ' ', '3',
    '0', '3', '2', 'N', 'G', 'C', ' ', '3', '0', '3', '2', 'N',
    'G', 'C', ' ', '3', '0', '3', '3', 'N', 'G', 'C', ' ', '3',
    '0', '3', '3', 'N', 'G', 'C', ' ', '3', '0', '3', '4', 'N',
    'G', 'C', ' ', '3', '0', '3', '4', 'N', 'G', 'C', ' ', '3',
    '0', '3', '5', 'N', 'G', 'C', ' ', '3', '0', '3', '5', 'N',
    'G', 'C', ' ', '3', '0', '3', '6', 'N', 'G', 'C', ' ', '3',
    '0', '3', '6', 'N', 'G', 'C', ' ', '3', '0', '3', '7', 'N',
    'G', 'C', ' ', '3', '0', '3', '7', 'N', 'G', 'C', ' ', '3',
    '0', '3', '8', 'N', 'G', 'C', ' ', '3', '0', '3', '8', 'N',
    'G', 'C', ' ', '3', '0', '3', '9', 'N', 'G', 'C', ' ', '3',
    '0', '3', '9', 'N', 'G', 'C', ' ', '3', '0', '4', '0', 'N',
    'G', 'C', ' ', '3', '0', '4', '0', 'N', 'G', 'C', ' ', '3',
    '0', '4', '1', 'N', 'G', 'C', ' ', '3', '0', '4', '1', 'N',
    'G', 'C', ' ', '3', '0', '4', '2', 'N', 'G', 'C', ' ', '3',
    '0', '4', '2', 'N', 'G', 'C', ' ', '3', '0', '4', '3', 'N',
    'G', 'C', ' ', '3', '0', '4', '3', 'N', 'G', 'C', ' ', '3',
    '0', '4', '4', 'N', 'G', 'C', ' ', '3', '0', '4', '4', 'N',
    'G', 'C', ' ', '3', '0', '4', '5', 'N', 'G', 'C', ' ', '3',
    '0', '4', '5', 'N', 'G', 'C', ' ', '3', '0', '4', '6', 'N',
    'G', 'C', ' ', '3', '0', '4', '6', 'N', 'G', 'C', ' ', '3',
    '0', '4', '7', 'N', 'G', 'C', ' ', '3', '0', '4', '7', 'N',
    'G', 'C', ' ', '3', '0', '4', '8', 'N', 'G', 'C', ' ', '3',
    '0', '4', '8', 'N', 'G', 'C', ' ', '3', '0', '4', '9', 'N',
    'G', 'C', ' ', '3', '0', '4', '9', 'N', 'G', 'C', ' ', '3',
    '0', '5', '0', 'N', 'G', 'C', ' ', '3', '0', '5', '0', 'N',
    'G', 'C', ' ', '3', '0', '5', '1', 'N', 'G', 'C', ' ', '3',
    '0', '5', '1', 'N', 'G', 'C', ' ', '3', '0', '5', '2', 'N',
    'G', 'C', ' ', '3', '0', '5', '2', 'N', 'G', 'C', ' ', '3',
    '0', '5', '3', 'N', 'G', 'C', ' ', '3', '0', '5', '3', 'N',
    'G', 'C', ' ', '3', '0', '5', '4', 'N', 'G', 'C', ' ', '3',
    '0', '5', '4', 'N', 'G', 'C', ' ', '3', '0', '5', '5', 'N',
    'G', 'C', ' ', '3', '0', '5', '5', 'N', 'G', 'C', ' ', '3',
    '0', '5', '6', 'N', 'G', 'C', ' ', '3', '0', '5', '6', 'N',
    'G', 'C', ' ', '3', '0', '5', '7', 'N', 'G', 'C', ' ', '3',
    '0', '5', '7', 'N', 'G', 'C', ' ', '3', '0', '5', '8', 'N',
    'G', 'C', ' ', '3', '0', '5', '8', 'N', 'G', 'C', ' ', '3',
    '0', '5', '9', 'N', 'G', 'C', ' ', '3', '0', '5', '9', 'N',
    'G', 'C', ' ', '3', '0', '6', '0', 'N', 'G', 'C', ' ', '3',
    '0', '6', '0', 'N', 'G', 'C', ' ', '3', '0', '6', '1', 'N',
    'G', 'C', ' ', '3', '0', '6', '1', 'N', 'G', 'C', ' ', '3',
    '0', '6', '2', 'N', 'G', 'C', ' ', '3', '0', '6', '2', 'N',
    'G', 'C', ' ', '3', '0', '6', '3', 'N', 'G', 'C', ' ', '3',
    '0', '6', '3', 'N', 'G', 'C', ' ', '3', '0', '6', '4', 'N',
    'G', 'C', ' ', '3', '0', '6', '4', 'N', 'G', 'C', ' ', '3',
    '0', '6', '5', 'N', 'G', 'C', ' ', '3', '0', '6', '5', 'N',
    'G', 'C', ' ', '3', '0', '6', '6', 'N', 'G', 'C', ' ', '3',
    '0', '6', '6', 'N', 'G', 'C', ' ', '3', '0', '6', '7', 'N',
    'G', 'C', ' ', '3', '0', '6', '7', 'N', 'G', 'C', ' ', '3',
    '0', '6', '8', 'N', 'G', 'C', ' ', '3', '0', '6', '8', 'N',
    'G', 'C', ' ', '3', '0', '6', '9', 'N', 'G', 'C', ' ', '3',
    '0', '6', '9', 'N', 'G', 'C', ' ', '3', '0', '7', '0', 'N',
    'G', 'C', ' ', '3', '0', '7', '0', 'N', 'G', 'C', ' ', '3',
    '0', '7', '1', 'N', 'G', 'C', ' ', '3', '0', '7', '1', 'N',
    'G', 'C', ' ', '3', '0', '7', '2', 'N', 'G', 'C', ' ', '3',
    '0', '7', '2', 'N', 'G', 'C', ' ', '3', '0', '7', '3', 'N',
    'G', 'C', ' ', '3', '0', '7', '3', 'N', 'G', 'C', ' ', '3',
    '0', '7', '4', 'N', 'G', 'C', ' ', '3', '0', '7', '4', 'N',
    'G', 'C', ' ', '3', '0', '7', '5', 'N', 'G', 'C', ' ', '3',
    '0', '7', '5', 'N', 'G', 'C', ' ', '3', '0', '7', '6', 'N',
    'G', 'C', ' ', '3', '0', '7', '6', 'N', 'G', 'C', ' ', '3',
    '0', '7', '7', 'N', 'G', 'C', ' ', '3', '0', '7', '7', 'N',
    'G', 'C', ' ', '3', '0', '7', '8', 'N', 'G', 'C', ' ', '3',
    '0', '7', '8', 'N', 'G', 'C', ' ', '3', '0', '7', '9', 'N',
    'G', 'C', ' ', '3', '0', '7', '9', 'N', 'G', 'C', ' ', '3',
    '0', '8', '0', 'N', 'G', 'C', ' ', '3', '0', '8', '0', 'N',
    'G', 'C', ' ', '3', '0', '8', '1', 'N', 'G', 'C', ' ', '3',
    '0', '8', '1', 'N', 'G', 'C', ' ', '3', '0', '8', '2', 'N',
    'G', 'C', ' ', '3', '0', '8', '2', 'N', 'G', 'C', ' ', '3',
    '0', '8', '3', 'N', 'G', 'C', ' ', '3', '0', '8', '3', 'N',
    'G', 'C', ' ', '3', '0', '8', '4', 'N', 'G', 'C', ' ', '3',
    '0', '8', '4', 'N', 'G', 'C', ' ', '3', '0', '8', '5', 'N',
    'G', 'C', ' ', '3', '0', '8', '5', 'N', 'G', 'C', ' ', '3',
    '0', '8', '6', 'N', 'G', 'C', ' ', '3', '0', '8', '6', 'N',
    'G', 'C', ' ', '3', '0', '8', '7', 'N', 'G', 'C', ' ', '3',
    '0', '8', '7', 'N', 'G', 'C', ' ', '3', '0', '8', '8', 'N',
    'G', 'C', ' ', '3', '0', '8', '8', 'N', 'G', 'C', ' ', '3',
    '0', '8', '9', 'N', 'G', 'C', ' ', '3', '0', '8', '9', 'N',
    'G', 'C', ' ', '3', '0', '9', '0', 'N', 'G', 'C', ' ', '3',
    '0', '9', '0', 'N', 'G', 'C', ' ', '3', '0', '9', '1', 'N',
    'G', 'C', ' ', '3', '0', '9', '1', 'N', 'G', 'C', ' ', '3',
    '0', '9', '2', 'N', 'G', 'C', ' ', '3', '0', '9', '2', 'N',
    'G', 'C', ' ', '3', '0', '9', '3', 'N', 'G', 'C', ' ', '3',
    '0', '9', '3', 'N', 'G', 'C', ' ', '3', '0', '9', '4', 'N',
    'G', 'C', ' ', '3', '0', '9', '4', 'N', 'G', 'C', ' ', '3',
    '0', '9', '5', 'N', 'G', 'C', ' ', '3', '0', '9', '5', 'N',
    'G', 'C', ' ', '3', '0', '9', '6', 'N', 'G', 'C', ' ', '3',
    '0', '9', '6', 'N', 'G', 'C', ' ', '3', '0', '9', '7', 'N',
    'G', 'C', ' ', '3', '0', '9', '7', 'N', 'G', 'C', ' ', '3',
    '0', '9', '8', 'N', 'G', 'C', ' ', '3', '0', '9', '8', 'N',
    'G', 'C', ' ', '3', '0', '9', '9', 'N', 'G', 'C', ' ', '3',
    '0', '9', '9', 'N', 'G', 'C', ' ', '3', '1', '0', '0', 'N',
    'G', 'C', ' ', '3', '1', '0', '0', 'N', 'G', 'C', ' ', '3',
    '1', '0', '1', 'N', 'G', 'C', ' ', '3', '1', '0', '1', 'N',
    'G', 'C', ' ', '3', '1', '0', '2', 'N', 'G', 'C', ' ', '3',
    '1', '0', '2', 'N', 'G', 'C', ' ', '3', '1', '0', '3', 'N',
    'G', 'C', ' ', '3', '1', '0', '3', 'N', 'G', 'C', ' ', '3',
    '1', '0', '4', 'N', 'G', 'C', ' ', '3', '1', '0', '4', 'N',
    'G', 'C', ' ', '3', '1', '0', '5', 'N', 'G', 'C', ' ', '3',
    '1', '0', '5', 'N', 'G', 'C', ' ', '3', '1', '0', '6', 'N',
    'G', 'C', ' ', '3', '1', '0', '6', 'N', 'G', 'C', ' ', '3',
    '1', '0', '7', 'N', 'G', 'C', ' ', '3', '1', '0', '7', 'N',
    'G', 'C', ' ', '3', '1', '0', '8', 'N', 'G', 'C', ' ', '3',
    '1', '0', '8', 'N', 'G', 'C', ' ', '3', '1', '0', '9', 'N',
    'G', 'C', ' ', '3', '1', '0', '9', 'N', 'G', 'C', ' ', '3',
    '1', '1', '0', 'N', 'G', 'C', ' ', '3', '1', '1', '0', 'N',
    'G', 'C', ' ', '3', '1', '1', '1', 'N', 'G', 'C', ' ', '3',
    '1', '1', '1', 'N', 'G', 'C', ' ', '3', '1', '1', '2', 'N',
    'G', 'C', ' ', '3', '1', '1', '2', 'N', 'G', 'C', ' ', '3',
    '1', '1', '3', 'N', 'G', 'C', ' ', '3', '1', '1', '3', 'N',
    'G', 'C', ' ', '3', '1', '1', '4', 'N', 'G', 'C', ' ', '3',
    '1', '1', '4', 'N', 'G', 'C', ' ', '3', '1', '1', '5', 'N',
    'G', 'C', ' ', '3', '1', '1', '5', 'N', 'G', 'C', ' ', '3',
    '1', '1', '6', 'N', 'G', 'C', ' ', '3', '1', '1', '6', 'N',
    'G', 'C', ' ', '3', '1', '1', '7', 'N', 'G', 'C', ' ', '3',
    '1', '1', '7', 'N', 'G', 'C', ' ', '3', '1', '1', '8', 'N',
    'G', 'C', ' ', '3', '1', '1', '8', 'N', 'G', 'C', ' ', '3',
    '1', '1', '9', 'N', 'G', 'C', ' ', '3', '1', '1', '9', 'N',
    'G', 'C', ' ', '3', '1', '2', '0', 'N', 'G', 'C', ' ', '3',
    '1', '2', '0', 'N', 'G', 'C', ' ', '3', '1', '2', '1', 'N',
    'G', 'C', ' ', '3', '1', '2', '1', 'N', 'G', 'C', ' ', '3',
    '1', '2', '2', 'N', 'G', 'C', ' ', '3', '1', '2', '2', 'N',
    'G', 'C', ' ', '3', '1', '2', '3', 'N', 'G', 'C', ' ', '3',
    '1', '2', '3', 'N', 'G', 'C', ' ', '3', '1', '2', '4', 'N',
    'G', 'C', ' ', '3', '1', '2', '4', 'N', 'G', 'C', ' ', '3',
    '1', '2', '5', 'N', 'G', 'C', ' ', '3', '1', '2', '5', 'N',
    'G', 'C', ' ', '3', '1', '2', '6', 'N', 'G', 'C', ' ', '3',
    '1', '2', '6', 'N', 'G', 'C', ' ', '3', '1', '2', '7', 'N',
    'G', 'C', ' ', '3', '1', '2', '7', 'N', 'G', 'C', ' ', '3',
    '1', '2', '8', 'N', 'G', 'C', ' ', '3', '1', '2', '8', 'N',
    'G', 'C', ' ', '3', '1', '2', '9', 'N', 'G', 'C', ' ', '3',
    '1', '2', '9', 'N', 'G', 'C', ' ', '3', '1', '3', '0', 'N',
    'G', 'C', ' ', '3', '1', '3', '0', 'N', 'G', 'C', ' ', '3',
    '1', '3', '1', 'N', 'G', 'C', ' ', '3', '1', '3', '1', 'N',
    'G', 'C', ' ', '3', '1', '3', '2', 'N', 'G', 'C', ' ', '3',
    '1', '3', '2', 'N', 'G', 'C', ' ', '3', '1', '3', '3', 'N',
    'G', 'C', ' ', '3', '1', '3', '3', 'N', 'G', 'C', ' ', '3',
    '1', '3', '4', 'N', 'G', 'C', ' ', '3', '1', '3', '4', 'N',
    'G', 'C', ' ', '3', '1', '3', '5', 'N', 'G', 'C', ' ', '3',
    '1', '3', '5', 'N', 'G', 'C', ' ', '3', '1', '3', '6', 'N',
    'G', 'C', ' ', '3', '1', '3', '6', 'N', 'G', 'C', ' ', '3',
    '1', '3', '7', 'N', 'G', 'C', ' ', '3', '1', '3', '7', 'N',
    'G', 'C', ' ', '3', '1', '3', '8', 'N', 'G', 'C', ' ', '3',
    '1', '3', '8', 'N', 'G', 'C', ' ', '3', '1', '3', '9', 'N',
    'G', 'C', ' ', '3', '1', '3', '9', 'N', 'G', 'C', ' ', '3',
    '1', '4', '0', 'N', 'G', 'C', ' ', '3', '1', '4', '0', 'N',
    'G', 'C', ' ', '3', '1', '4', '1', 'N', 'G', 'C', ' ', '3',
    '1', '4', '1', 'N', 'G', 'C', ' ', '3', '1', '4', '2', 'N',
    'G', 'C', ' ', '3', '1', '4', '2', 'N', 'G', 'C', ' ', '3',
    '1', '4', '3', 'N', 'G', 'C', ' ', '3', '1', '4', '3', 'N',
    'G', 'C', ' ', '3', '1', '4', '4', 'N', 'G', 'C', ' ', '3',
    '1', '4', '4', 'N', 'G', 'C', ' ', '3', '1', '4', '5', 'N',
    'G', 'C', ' ', '3', '1', '4', '5', 'N', 'G', 'C', ' ', '3',
    '1', '4', '6', 'N', 'G', 'C', ' ', '3', '1', '4', '6', 'N',
    'G', 'C', ' ', '3', '1', '4', '7', 'N', 'G', 'C', ' ', '3',
    '1', '4', '7', 'N', 'G', 'C', ' ', '3', '1', '4', '8', 'N',
    'G', 'C', ' ', '3', '1', '4', '8', 'N', 'G', 'C', ' ', '3',
    '1', '4', '9', 'N', 'G', 'C', ' ', '3', '1', '4', '9', 'N',
    'G', 'C', ' ', '3', '1', '5', '0', 'N', 'G', 'C', ' ', '3',
    '1', '5', '0', 'N', 'G', 'C', ' ', '3', '1', '5', '1', 'N',
    'G', 'C', ' ', '3', '1', '5', '1', 'N', 'G', 'C', ' ', '3',
    '1', '5', '2', 'N', 'G', 'C', ' ', '3', '1', '5', '2', 'N',
    'G', 'C', ' ', '3', '1', '5', '3', 'N', 'G', 'C', ' ', '3',
    '1', '5', '3', 'N', 'G', 'C', ' ', '3', '1', '5', '4', 'N',
    'G', 'C', ' ', '3', '1', '5', '4', 'N', 'G', 'C', ' ', '3',
    '1', '5', '5', 'N', 'G', 'C', ' ', '3', '1', '5', '5', 'N',
    'G', 'C', ' ', '3', '1', '5', '6', 'N', 'G', 'C', ' ', '3',
    '1', '5', '6', 'N', 'G', 'C', ' ', '3', '1', '5', '7', 'N',
    'G', 'C', ' ', '3', '1', '5', '7', 'N', 'G', 'C', ' ', '3',
    '1', '5', '8', 'N', 'G', 'C', ' ', '3', '1', '5', '8', 'N',
    'G', 'C', ' ', '3', '1', '5', '9', 'N', 'G', 'C', ' ', '3',
    '1', '5', '9', 'N', 'G', 'C', ' ', '3', '1', '6', '0', 'N',
    'G', 'C', ' ', '3', '1', '6', '0', 'N', 'G', 'C', ' ', '3',
    '1', '6', '1', 'N', 'G', 'C', ' ', '3', '1', '6', '1', 'N',
    'G', 'C', ' ', '3', '1', '6', '2', 'N', 'G', 'C', ' ', '3',
    '1', '6', '2', 'N', 'G', 'C', ' ', '3', '1', '6', '3', 'N',
    'G', 'C', ' ', '3', '1', '6', '3', 'N', 'G', 'C', ' ', '3',
    '1', '6', '4', 'N', 'G', 'C', ' ', '3', '1', '6', '4', 'N',
    'G', 'C', ' ', '3', '1', '6', '5', 'N', 'G', 'C', ' ', '3',
    '1', '6', '5', 'N', 'G', 'C', ' ', '3', '1', '6', '6', 'N',
    'G', 'C', ' ', '3', '1', '6', '6', 'N', 'G', 'C', ' ', '3',
    '1', '6', '7', 'N', 'G', 'C', ' ', '3', '1', '6', '7', 'N',
    'G', 'C', ' ', '3', '1', '6', '8', 'N', 'G', 'C', ' ', '3',
    '1', '6', '8', 'N', 'G', 'C', ' ', '3', '1', '6', '9', 'N',
    'G', 'C', ' ', '3', '1', '6', '9', 'N', 'G', 'C', ' ', '3',
    '1', '7', '0', 'N', 'G', 'C', ' ', '3', '1', '7', '0', 'N',
    'G', 'C', ' ', '5', '1', '2', '8', 'N', 'G', 'C', ' ', '5',
    '1', '2', '8', 'N', 'G', 'C', ' ', '6', '7', '4', '4', 'N',
    'G', 'C', ' ', '6', '7', '4', '4', 'P', 'h', 'a', 'n', 't',
    'o', 'm', ' ', 'G', 'a', 'l', 'a', 'x', 'y', 'M', 'e', 's',
    's', 'i', 'e', 'r', ' ', '0', '7', '4', 'P', 'i', 'n', 'w',
    'h', 'e', 'e', 'l', ' ', 'G', 'a', 'l', 'a', 'x', 'y', 'M',
    'e', 's', 's', 'i', 'e', 'r', ' ', '1', '0', '1', 'S', 'o',
    'm', 'b', 'r', 'e', 'r', 'o', ' ', 'G', 'a', 'l', 'a', 'x',
    'y', 'M', 'e', 's', 's', 'i', 'e', 'r', ' ', '1', '0', '4',
    'S', 'o', 'u', 't', 'h', 'e', 'r', 'n', ' ', 'P', 'i', 'n',
    'w', 'h', 'e', 'e', 'l', 'M', 'e', 's', 's', 'i', 'e', 'r',
    ' ', '0', '8', '3', 'S', 'u', 'n', 'f', 'l', 'o', 'w', 'e',
    'r', ' ', 'G', 'a', 'l', 'a', 'x', 'y', 'M', 'e', 's', 's',
    'i', 'e', 'r', ' ', '0', '6', '3', 'T', 'r', 'i', 'a', 'n',
    'g', 'u', 'l', 'u', 'm', ' ', 'G', 'a', 'l', 'a', 'x', 'y',
    'M', 'e', 's', 's', 'i', 'e', 'r', ' ', '0', '3', '3', 'V',
    'a', 'c', 'u', 'u', 'm', ' ', 'C', 'l', 'e', 'a', 'n', 'e',
    'r', ' ', 'G', 'a', 'l', 'a', 'x', 'y', 'M', 'e', 's', 's',
    'i', 'e', 'r', ' ', '1', '0', '9', 'V', 'i', 'r', 'g', 'o',
    ' ', 'A', 'M', 'e', 's', 's', 'i', 'e', 'r', ' ', '0', '8',
    '7', 'W', 'h', 'i', 'r', 'l', 'p', 'o', 'o', 'l', ' ', 'G',
    'a', 'l', 'a', 'x', 'y', 'M', 'e', 's', 's', 'i', 'e', 'r',
    ' ', '0', '5', '1', 'M', 'e', 's', 's', 'i', 'e', 'r', ' ',
    '0', '0', '8', 'M', 'e', 's', 's', 'i', 'e', 'r', ' ', '0',
    '0', '8', 'M', 'e', 's', 's', 'i', 'e', 'r', ' ', '0', '1',
    '6', 'M', 'e', 's', 's', 'i', 'e', 'r', ' ', '0', '1', '6',
    'M', 'e', 's', 's', 'i', 'e', 'r', ' ', '0', '1', '7', 'M',
    'e', 's', 's', 'i', 'e', 'r', ' ', '0', '1', '7', 'M', 'e',
    's', 's', 'i', 'e', 'r', ' ', '0', '2', '0', 'M', 'e', 's',
    's', 'i', 'e', 'r', ' ', '0', '2', '0', 'M', 'e', 's', 's',
    'i', 'e', 'r', ' ', '0', '4', '2', 'M', 'e', 's', 's', 'i',
    'e', 'r', ' ', '0', '4', '2', 'M', 'e', 's', 's', 'i', 'e',
    'r', ' ', '0', '4', '3', 'M', 'e', 's', 's', 'i', 'e', 'r',
    ' ', '0', '4', '3', 'M', 'e', 's', 's', 'i', 'e', 'r', ' ',
    '0', '7', '8', 'M', 'e', 's', 's', 'i', 'e', 'r', ' ', '0',
    '7', '8', 'N', 'G', 'C', ' ', '3', '3', '7', '2', 'N', 'G',
    'C', ' ', '3', '3', '7', '2', 'N', 'G', 'C', ' ', '7', '0',
    '0', '0', 'N', 'G', 'C', ' ', '7', '0', '0', '0', 'M', 'e',
    's', 's', 'i', 'e', 'r', ' ', '0', '2', '7', 'M', 'e', 's',
    's', 'i', 'e', 'r', ' ', '0', '2', '7', 'M', 'e', 's', 's',
    'i', 'e', 'r', ' ', '0', '5', '7', 'M', 'e', 's', 's', 'i',
    'e', 'r', ' ', '0', '5', '7', 'M', 'e', 's', 's', 'i', 'e',
    'r', ' ', '0', '7', '6', 'M', 'e', 's', 's', 'i', 'e', 'r',
    ' ', '0', '7', '6', 'M', 'e', 's', 's', 'i', 'e', 'r', ' ',
    '0', '9', '7', 'M', 'e', 's', 's', 'i', 'e', 'r', ' ', '0',
    '9', '7', 'N', 'G', 'C', ' ', '7', '0', '0', '9', 'N', 'G',
    'C', ' ', '7', '0', '0', '9', 'N', 'G', 'C', ' ', '7', '0',
    '2', '7', 'N', 'G', 'C', ' ', '7', '0', '2', '7', 'N', 'G',
    'C', ' ', '7', '2', '9', '3', 'N', 'G', 'C', ' ', '7', '2',
    '9', '3',
};
static constexpr size_t kCatalogStringTableSize = sizeof(kCatalogStrings);
static constexpr size_t kCatalogEntryCount = sizeof(kCatalogEntries) / sizeof(kCatalogEntries[0]);
